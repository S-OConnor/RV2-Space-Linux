## layers/meta-company/conf/distro/rv2-sgl.conf
```bitbake
require conf/distro/poky.conf

DISTRO = "rv2-sgl"
DISTRO_NAME = "RV2 Space Linux (SGL-oriented)"
DISTRO_VERSION = "0.1"
DISTRO_CODENAME = ""
MAINTAINER = "meta-company maintainers <maintainers@example.com>"

# Keep the poky override active so meta-poky's :poky-scoped tweaks still apply
# on top of our own rv2-sgl override (same trick poky-altcfg uses).
DISTROOVERRIDES = "poky:rv2-sgl"

# Modern supported one-liner for selecting the init manager. Do NOT use the
# legacy VIRTUAL-RUNTIME_init_manager / DISTRO_FEATURES_BACKFILL trio
# (meta-sgl's kas/systemd.yml still shows that legacy pattern).
INIT_MANAGER = "systemd"

# systemd on modern oe-core requires usrmerge; appending is harmless if poky
# already sets it.
DISTRO_FEATURES:append = " usrmerge"

# ---------------------------------------------------------------------------
# SGL integration placeholders
# ---------------------------------------------------------------------------
# Security hardening baseline candidates:
# DISTRO_FEATURES:append = " seccomp pam"
#
# Once meta-sgl-core publishes policy include files, require them here. Today
# meta-sgl-core ships only conf/layer.conf -- nothing to require yet:
# require conf/distro/include/sgl-policy.inc
#
# Watchdog is NOT a distro feature: runtime watchdog coverage comes from the
# watchdog package (oe-core) and/or systemd RuntimeWatchdogSec=. SGL
# safety-monitor / supervision hooks will land here.
#
# Future OTA update strategy (e.g. RAUC / SWUpdate A/B -- to be selected with
# SGL guidance) will be configured here.
#
# Observability stack (logging / telemetry) placeholders will land here.
```

## layers/meta-company/conf/layer.conf
```bitbake
# meta-company: product layer for the RV2 SGL starter.
# Owns: rv2-sgl distro, rv2-sgl-image, packagegroup-rv2-sgl-base, hello-rv2.

BBPATH .= ":${LAYERDIR}"

BBFILES += "${LAYERDIR}/recipes-*/*/*.bb \
            ${LAYERDIR}/recipes-*/*/*.bbappend"

BBFILE_COLLECTIONS += "meta-company"
BBFILE_PATTERN_meta-company = "^${LAYERDIR}/"
BBFILE_PRIORITY_meta-company = "10"
LAYERVERSION_meta-company = "1"

# core               = openembedded-core (meta)
# yocto              = meta-poky (rv2-sgl.conf requires conf/distro/poky.conf)
# openembedded-layer = meta-oe (nano)
# networking-layer   = meta-networking (chrony)
LAYERDEPENDS_meta-company = "core yocto openembedded-layer networking-layer"

# ADJUST HERE on a Yocto series bump (keep in sync with kas/include/rv2-base.yml).
LAYERSERIES_COMPAT_meta-company = "wrynose"
```
